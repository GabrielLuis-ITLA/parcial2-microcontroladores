## Codigo_Fuente/sdks/frdm_mcxa156_blank_sdk/mcuxsdk/middleware/safety_iec60730b/zephyr/samples/safety/sample.yaml
```yaml
sample:
  name: Safety iec60730b Sample
tests:
  sample.iec60730b.safety:
    tags:
      - safety
    integration_platforms:
      - frdm_mcxa156
      - frdm_mcxa266
      - frdm_mcxa344
      - frdm_mcxc444
      - frdm_mcxn947/mcxn947/cpu0
      - frdm_mcxn236
      - frdm_imxrt1186/mimxrt1186/cm33
      - frdm_rw612
      - mimxrt1170_evk/mimxrt1176/cm7
      - lpcxpresso55s06
      - lpcxpresso55s16
      - lpcxpresso55s28
      - lpcxpresso55s36
      - lpcxpresso55s69/lpc55s69/cpu0
      - nrf54l15dk/nrf54l15/cpuapp
```
